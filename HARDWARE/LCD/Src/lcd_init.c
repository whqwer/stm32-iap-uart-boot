#include "lcd_init.h"
#include "spi_func.h"

/*
 * LCD init sequence – length-prefixed encoding (safe for all data values):
 *   0xFE <reg> <len> [<d0> ... <dN-1>]  — write command reg + N data bytes
 *   0xFF <ms>                            — HAL_Delay(ms)
 *   0xFC                                 — LCD_RES_Set()
 *   0xFD                                 — LCD_RES_CLR()
 *   0x00                                 — end of table
 *
 * Unlike a marker-scan approach this encoding is unambiguous even when data
 * bytes happen to equal 0xFE / 0xFF / 0xFD / 0xFC.
 */
static const uint8_t lcd_init_seq[] = {
    0xFC,  /* RES_SET */
    0xFF, 100,  /* delay 100 ms */
    0xFD,  /* RES_CLR */
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    0xFE, 0x39, 0,
    0x00  /* END */
};

void LCD_Address_Set(uint16_t xs, uint16_t ys, uint16_t xe, uint16_t ye)
{
    LCD_WR_REG(0x2A);
    LCD_WR_DATA8(xs >> 8);
    LCD_WR_DATA8(xs & 0xFF);
    LCD_WR_DATA8(xe >> 8);
    LCD_WR_DATA8(xe & 0xFF);
    LCD_WR_REG(0x2B);
    LCD_WR_DATA8(ys >> 8);
    LCD_WR_DATA8(ys & 0xFF);
    LCD_WR_DATA8(ye >> 8);
    LCD_WR_DATA8(ye & 0xFF);
    LCD_WR_REG(0x2c);
    HAL_Delay(5);
    LCD_WR_REG(0x2c);
}

/* DMA buffer: 32-byte aligned for STM32H5 D-cache coherency */
__ALIGNED(32) uint8_t screen_fill[240];

void LCD_Fill(uint16_t xs, uint16_t ys, uint16_t xe, uint16_t ye, uint16_t color)
{
    uint16_t i, j, cnt=0;
    LCD_Address_Set(xs, ys, xe - 1, ye - 1);
    for (j = ys; j < ye; j++)
    {
        for (i = xs; i < xe; i++)
        {
        	screen_fill[cnt++]=(color>>8) & 0xFF;
        	screen_fill[cnt++]=color & 0xFF;
        }
        LCD_WR_Busbuf(screen_fill, cnt);
        cnt = 0;
    }
}

void LCD_Init(void)
{
    LCD_GPIOInit();
    const uint8_t *p = lcd_init_seq;
    while (*p != 0x00u) {
        if      (*p == 0xFCu) { LCD_RES_Set();  p++;                          }
        else if (*p == 0xFDu) { LCD_RES_Clr();  p++;                          }
        else if (*p == 0xFFu) { p++; HAL_Delay(*p++);                         }
        else /* 0xFE: cmd */ {
            p++;                        /* skip 0xFE marker  */
            LCD_WR_REG(*p++);           /* send register     */
            uint8_t n = *p++;           /* data byte count   */
            while (n--) { LCD_WR_DATA8(*p++); }
        }
    }
}
